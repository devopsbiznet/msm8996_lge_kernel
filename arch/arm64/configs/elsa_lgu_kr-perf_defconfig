## arch/arm64/configs/elsa_lgu_kr-perf_defconfig
```kconfig
CONFIG_WLAN_80211=y
CONFIG_MAC80211=y
CONFIG_MAC80211_LEDS=y
CONFIG_RT2X00=y
CONFIG_RT2500USB=y
CONFIG_RT73USB=y
CONFIG_RT2X00_LIB_USB=y
CONFIG_RT2X00_LIB=y
CONFIG_RT2X00_LIB_FIRMWARE=y
CONFIG_RT2X00_LIB_CRYPTO=y
CONFIG_RT2X00_LIB_LEDS=y
CONFIG_RTL8812AU=y
#CONFIG_RTL8192CU=y
#CONFIG_AT76C50X_USB=y
#firmware http://linux-lc100020.sourceforge.net/
#CONFIG_USB_ZD1201=y
#CONFIG_USB_NET_RNDIS_WLAN=y
#CONFIG_AR5523=y
#CONFIG_ATH5K=y
#CONFIG_ATH6KL=y
#CONFIG_ATH6KL_USB=y
#CONFIG_ATH6KL_SDIO=y
#CONFIG_RTL8187=y

include elsa_lgu_kr_common
include elsa_common-perf
#############################################################
#   Fix kernel command-line (may or may not be important)   #
#############################################################
CONFIG_CMDLINE="androidboot.bl_unlock_complete=false androidboot.authorized_kernel=true"
CONFIG_CMDLINE_EXTEND=y
CONFIG_CMDLINE_SAR_ENABLE0=y
CONFIG_CMDLINE_SAR_SEARCH0=" model.name=LG-US996 "
CONFIG_CMDLINE_SAR_REPLACE0=" model.name=LG-F800l "
CONFIG_CMDLINE_SAR_ENABLE1=y
CONFIG_CMDLINE_SAR_SEARCH1=" androidboot.serialno=LGUS996"
CONFIG_CMDLINE_SAR_REPLACE1=" androidboot.serialno=LGF800"
CONFIG_CMDLINE_SAR_ENABLE2=y
CONFIG_CMDLINE_SAR_SEARCH2=" slub_debug=FZPU "
CONFIG_CMDLINE_SAR_REPLACE2=" "
```
